// SPDX-License-Identifier: GPL-2.0-only OR MIT
/* BeagleY-AI header routes adapted from BeagleBoard.org DeviceTrees.
 * Copyright (C) BeagleBoard.org Foundation
 * See docs/expansion.md for the pinned source and connector identities.
 */
/dts-v1/;
/plugin/;
#include <dt-bindings/gpio/gpio.h>
#include <arm64/ti/k3-pinctrl.h>
/ { compatible = "beagle,am67a-beagley-ai"; };
&main_uart1 { pinctrl-names = "default"; pinctrl-0 = <&main_uart1_pins_default>; status = "okay"; };
