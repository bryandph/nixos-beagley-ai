// SPDX-License-Identifier: GPL-2.0-only OR MIT
/* BeagleY-AI header routes adapted from BeagleBoard.org DeviceTrees.
 * Copyright (C) BeagleBoard.org Foundation
 * See docs/expansion.md for the pinned source and connector identities.
 */
/dts-v1/;
/plugin/;
#include <dt-bindings/gpio/gpio.h>
#include <arm64/ti/k3-pinctrl.h>
/ { compatible = "beagle,am67a-beagley-ai"; };
&mcu_pmx0 {
  beagley_header_spi: beagley-header-spi-pins {
    pinctrl-single,pins = <
      J722S_MCU_IOPAD(0x000, PIN_OUTPUT, 0)
      J722S_MCU_IOPAD(0x008, PIN_INPUT, 0)
      J722S_MCU_IOPAD(0x00c, PIN_OUTPUT, 0)
      J722S_MCU_IOPAD(0x010, PIN_INPUT, 0)
    >;
  };
};
&mcu_spi0 { pinctrl-names = "default"; pinctrl-0 = <&beagley_header_spi>; ti,pindir-d0-out; status = "okay"; };
